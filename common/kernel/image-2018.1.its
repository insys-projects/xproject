## common/kernel/image-2018.1.its
```
/dts-v1/;

/ {
        description = "U-Boot fitImage for PetaLinux/4.14-xilinx-v2018.2+gitAUTOINC+ad4cd988ba/plnx-zynq7";
        #address-cells = <1>;

        images {
                kernel@1 {
                        description = "Linux kernel";
                        data = /incbin/("linux.bin");
                        type = "kernel";
                        arch = "arm";
                        os = "linux";
                        compression = "gzip";
                        load = <0x8000>;
                        entry = <0x8000>;
                        hash@1 {
                                algo = "sha1";
                        };
                };
                fdt@system-top.dtb {
                        description = "Flattened Device Tree blob";
                        data = /incbin/("/home/karak/xprj/bardy-ext/petalinux/fmc130e_v11_z045_fmctest/project/build/tmp/work/plnx_zynq7-xilinx-linux-gnueabi/linux-xlnx/4.14-xilinx-v2018.2+gitAUTOINC+ad4cd988ba-r0/recipe-sysroot/boot/devicetree/system-top.dtb");
                        type = "flat_dt";
                        arch = "arm";
                        compression = "none";
                        hash@1 {
                                algo = "sha1";
                        };
                };
        };

        configurations {
                default = "conf@system-top.dtb";
                conf@system-top.dtb {
                        description = "1 Linux kernel, FDT blob";
                        kernel = "kernel@1";
                        fdt = "fdt@system-top.dtb";
                        hash@1 {
                                algo = "sha1";
                        };
                };
        };
};
```

## common/kernel/image-2018.2-full.its
```
/dts-v1/;

/ {
	description = "U-Boot fitImage for plnx_arm kernel";
	#address-cells = <1>;

	images {
		kernel@0 {
			description = "Linux Kernel";
			data = /incbin/("zImage");
			type = "kernel";
			arch = "arm";
			os = "linux";
			compression = "none";
			load = <0x8000>;
			entry = <0x8000>;
			hash@1 {
				algo = "sha1";
			};
		};
		fdt@0 {
			description = "Flattened Device Tree blob";
			data = /incbin/("system.dtb");
			type = "flat_dt";
			arch = "arm";
			compression = "none";
			hash@1 {
				algo = "sha1";
			};
		};
		ramdisk@0 {
			description = "ramdisk";
			data = /incbin/("rootfs.cpio.gz");
			type = "ramdisk";
			arch = "arm";
			os = "linux";
			compression = "none";
			hash@1 {
				algo = "sha1";
			};
		};
	};
	configurations {
		default = "conf@2";
		conf@0 {
			description = "Boot Linux kernel with FDT blob + ramdisk";
			kernel = "kernel@0";
			fdt = "fdt@0";
			ramdisk = "ramdisk@0";
			hash@1 {
				algo = "sha1";
			};
		};
		conf@1 {
			description = "Boot Linux kernel with FDT blob";
			kernel = "kernel@0";
			fdt = "fdt@0";
			hash@1 {
				algo = "sha1";
			};
		};
		conf@2 {
			description = "Boot Linux kernel without FDT blob and without ramdisk";
			kernel = "kernel@0";
			hash@1 {
				algo = "sha1";
			};
		};
		conf@3 {
			description = "Boot Linux kernel without FDT blob and with ramdisk";
			kernel = "kernel@0";
			ramdisk = "ramdisk@0";
			hash@1 {
				algo = "sha1";
			};
		};
	};
};
```

## common/kernel/image-2018.2-kernel.its
```
/dts-v1/;

/ {
	description = "U-Boot fitImage for plnx_arm kernel";
	#address-cells = <1>;

	images {
		kernel@0 {
			description = "Linux Kernel";
			data = /incbin/("zImage");
			type = "kernel";
			arch = "arm";
			os = "linux";
			compression = "none";
			load = <0x8000>;
			entry = <0x8000>;
			hash@1 {
				algo = "sha1";
			};
		};
	};
	configurations {
		default = "conf@0";
		conf@0 {
			description = "Boot Linux kernel without FDT blob and without ramdisk";
			kernel = "kernel@0";
			hash@1 {
				algo = "sha1";
			};
		};
	};
};
```
